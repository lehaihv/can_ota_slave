## sdkconfig.defaults
```kconfig
# Target
CONFIG_IDF_TARGET="esp32s3"

# Flash size — change to 8MB if your board has 8MB
CONFIG_ESPTOOLPY_FLASHSIZE_4MB=y
CONFIG_ESPTOOLPY_FLASHSIZE="4MB"
#CONFIG_ESPTOOLPY_FLASHSIZE_8MB=y
#CONFIG_ESPTOOLPY_FLASHSIZE="8MB"

# Two OTA slots required — custom table for 4MB flash
CONFIG_PARTITION_TABLE_TWO_OTA=y
CONFIG_PARTITION_TABLE_CUSTOM=y
CONFIG_PARTITION_TABLE_CUSTOM_FILENAME="partitions.csv"

# Main task stack
CONFIG_ESP_MAIN_TASK_STACK_SIZE=8192

# OTA rollback
CONFIG_BOOTLOADER_APP_ROLLBACK_ENABLE=y

# UART0 for logs
CONFIG_ESP_CONSOLE_UART_NUM=0

# Reduce IRAM usage — uncomment if linker reports IRAM overflow
# CONFIG_ESP_WIFI_IRAM_OPT=n
# CONFIG_ESP_WIFI_RX_IRAM_OPT=n
# CONFIG_SPI_MASTER_ISR_IN_IRAM=n
# CONFIG_SPI_SLAVE_ISR_IN_IRAM=n
# CONFIG_RINGBUF_PLACE_ISR_FUNCTIONS_INTO_FLASH=y
# CONFIG_RINGBUF_PLACE_FUNCTIONS_INTO_FLASH=y
```
